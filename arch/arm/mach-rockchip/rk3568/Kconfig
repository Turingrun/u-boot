## arch/arm/mach-rockchip/rk3568/Kconfig
```kconfig
if ROCKCHIP_RK3568

config TARGET_EVB_RK3568
	bool "EVB_RK3568"
	select BOARD_LATE_INIT
	help
	  RK3568 EVB is a evaluation board for Rockchp RK3568.

config TARGET_OK3568_C
	bool "Forlinx OK3568-C"
	select BOARD_LATE_INIT
	help
	  Support Forlinx OK3568-C board.

config SYS_SOC
	default "rockchip"

config SYS_MALLOC_F_LEN
	default 0x400

source board/rockchip/evb_rk3568/Kconfig
source board/forlinx/ok3568/Kconfig

endif
```

## board/forlinx/ok3568/Kconfig
```kconfig
if TARGET_OK3568_C

config SYS_BOARD
	default "ok3568"

config SYS_VENDOR
	default "forlinx"

config SYS_CONFIG_NAME
	default "ok3568"

config BOARD_SPECIFIC_OPTIONS # dummy
	def_bool y

endif
```
